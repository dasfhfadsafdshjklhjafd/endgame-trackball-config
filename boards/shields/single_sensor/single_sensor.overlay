&zip_2s_mixer {
	single-sensor-mode;
	single-sensor-primary = <2>;
	/* Calibrated from forward/back + left/right sweep (1000 == 1.0). */
	single-sensor-transform = <(1384) (-1219) 0 (655)>;
};

&trackball_primary {
	status = "disabled";
};

&trackball_primary_listener {
	status = "disabled";
};

