## Kconfig
```kconfig
menu "Efog trackball options"

config EFOG_SCROLL_STEP
	int "Scroll sensitivity step (thousandths)"
	default 10
	range 1 100
	help
	  Step applied by scroll sensitivity behaviors. Units are 1/1000, so 10 equals
	  a 0.010 change to the twist coefficient.

config EFOG_SCROLL_MIN_STEP
	int "Scroll sensitivity minimum step count"
	default 2
	range 1 255
	help
	  Lower bound (in multiples of CONFIG_EFOG_SCROLL_STEP) for scroll sensitivity.

config EFOG_SCROLL_MAX_STEP
	int "Scroll sensitivity maximum step count"
	default 12
	range 1 255
	help
	  Upper bound (in multiples of CONFIG_EFOG_SCROLL_STEP) for scroll sensitivity.

config EFOG_SCROLL_TOGGLE_STEP
	int "Scroll toggle step delta (thousandths)"
	default 30
	range 1 255
	help
	  Step size used by the toggle behavior. Units are 1/1000.

config EFOG_SCROLL_TOGGLE_MIN
	int "Scroll toggle minimum step count"
	default 1
	range 1 255

config EFOG_SCROLL_TOGGLE_MAX
	int "Scroll toggle maximum step count"
	default 2
	range 1 255

config EFOG_SCROLL_DEFAULT
	int "Default scroll sensitivity (thousandths)"
	default 1000
	range 1 2000
	help
	  Base twist scroll coefficient applied at boot before sensitivity behaviors
	  or saved settings adjust it. Units are 1/1000.

config EFOG_SINGLE_SENSOR_BLE_PRESET
	bool "Use low-latency BLE preset"
	default y
	help
	  Tighten the BLE connection interval and shrink the HID queues to keep
	  pointer latency low. Disable to fall back to ZMK's standard BLE behavior.

config EFOG_SETTINGS_WIPE_ON_BOOT
	bool "Erase saved mixer settings on boot"
	default n
	help
	  When enabled, the firmware removes the persisted P2SM sensitivity values
	  during startup. Flash once with this option, then rebuild without it to
	  avoid wiping on every boot.

endmenu

if EFOG_SINGLE_SENSOR_BLE_PRESET

config BT_PERIPHERAL_PREF_MIN_INT
	default 6

config BT_PERIPHERAL_PREF_MAX_INT
	default 6

config BT_PERIPHERAL_PREF_LATENCY
	default 0

config BT_PERIPHERAL_PREF_TIMEOUT
	default 400

config ZMK_BLE_FORCE_CONN_PARAMS
	default y

config ZMK_BLE_FORCE_CONN_PARAMS_MAX_INTERVAL
	default 6

config ZMK_BLE_FORCE_CONN_PARAMS_MAX_LATENCY
	default 0

config ZMK_BLE_FORCE_CONN_PARAMS_RETRY_MS
	default 500

config ZMK_BLE_FORCE_CONN_PARAMS_MAX_RETRIES
	default 4

config ZMK_BLE_FORCE_CONN_PARAMS_DISCONNECT
	default y

config ZMK_BLE_THREAD_PRIORITY
	default 3

config ZMK_BLE_THREAD_STACK_SIZE
	default 2048

config ZMK_BLE_MOUSE_REPORT_QUEUE_SIZE
	default 1

config ZMK_BLE_KEYBOARD_REPORT_QUEUE_SIZE
	default 1

config ZMK_BLE_CONSUMER_REPORT_QUEUE_SIZE
	default 1

config EFOG_BLE_CONN_PARAMS_RESUME_DELAY
	int "Delay before forcing BLE params after activity (ms)"
	default 200

endif

menu "Efog BLE options"

config EFOG_BLE_BASE_MIN_INT
	int "Stable reconnect minimum interval (1.25 ms units)"
	default 12
	range 6 3200
	help
	  Preferred minimum connection interval requested immediately after (re)connection.
	  Pick a value the host is likely to accept during wake from sleep. Units are 1.25 ms.

config EFOG_BLE_BASE_MAX_INT
	int "Stable reconnect maximum interval (1.25 ms units)"
	default 24
	range 6 3200
	help
	  Preferred maximum connection interval requested immediately after (re)connection.
	  Keep this close to the minimum to minimise latency without triggering host timeouts.

config EFOG_BLE_BASE_LATENCY
	int "Stable reconnect slave latency"
	default 0
	range 0 499
	help
	  Peripheral latency value used during the stable reconnect phase. Zero disables latency.

config EFOG_BLE_FAST_MIN_INT
	int "Fast mode minimum interval (1.25 ms units)"
	default 6
	range 6 3200
	help
	  Minimum connection interval requested once the link is active and responsive.

config EFOG_BLE_FAST_MAX_INT
	int "Fast mode maximum interval (1.25 ms units)"
	default 6
	range 6 3200
	help
	  Maximum interval paired with the fast-mode minimum interval.

config EFOG_BLE_FAST_LATENCY
	int "Fast mode slave latency"
	default 0
	range 0 499
	help
	  Latency used when requesting the fast-mode connection parameters.

config EFOG_BLE_FAST_REQUEST_DELAY_MS
	int "Delay before fast-mode request (ms)"
	default 6000
	range 100 600000
	help
	  Duration to wait after the host updates parameters before attempting to request
	  the fast interval. Gives the operating system time to settle after resume.

config EFOG_BLE_FAST_REQUEST_RETRIES
	int "Maximum fast-mode retries"
	default 2
	range 0 10
	help
	  Number of additional attempts to request the fast parameters if the host rejects
	  the first request. Set to zero to disable retries entirely.

config EFOG_BLE_FAST_REQUEST_SPACING_MS
	int "Spacing between fast-mode retries (ms)"
	default 1500
	range 100 60000
	help
	  Delay between repeated fast parameter requests when retries are enabled.

config EFOG_BLE_FAST_RETRY_FOREVER
	bool "Keep requesting fast-mode parameters indefinitely"
	default n
	help
	  Keep rescheduling the fast-mode worker even after the retry budget above is exhausted.
	  Disable to stop requesting once CONFIG_EFOG_BLE_FAST_REQUEST_RETRIES attempts have run.

config EFOG_BLE_FAST_FORCE_DISCONNECT
	bool "Disconnect if fast-mode parameters never land"
	default n
	help
	  Drop the BLE link when the host ignores the fast interval for too long so it reconnects and
	  renegotiates fresh parameters.

config EFOG_BLE_FAST_FORCE_DISCONNECT_ATTEMPTS
	int "Fast-mode requests before disconnecting"
	depends on EFOG_BLE_FAST_FORCE_DISCONNECT
	default 24
	range 1 255
	help
	  Number of consecutive failed fast parameter requests before triggering a disconnect. Multiply
	  by CONFIG_EFOG_BLE_FAST_REQUEST_SPACING_MS to compute the total wait duration.

endmenu
```

## boards/arm/efogtech_trackball_0/Kconfig
```kconfig
menu "Endgame Trackball options"

config EFOGTECH_TRACKBALL_PMW3610_EXTRA_WAKE_DELAY
    bool "Add extra PMW3610 wake delay"
    help
      Enable this if you need additional time for the PMW3610 sensors to wake
      up before the driver performs the product ID check. Useful for marginal
      hardware or when running without the Studio debug snippets.

config EFOGTECH_TRACKBALL_PMW3610_EXTRA_WAKE_DELAY_MS
    int "PMW3610 extra wake delay (ms)"
    depends on EFOGTECH_TRACKBALL_PMW3610_EXTRA_WAKE_DELAY
    range 0 500
    default 75
    help
      Delay to insert ahead of the PMW3610 init sequence. Increase if sensors
      still report 0xFF product IDs during startup.

endmenu
```

## boards/arm/efogtech_trackball_0/Kconfig.board
```kconfig
config BOARD_EFOGTECH_TRBL_52833
    bool "efogtech_trackball_0"
    depends on SOC_NRF52833_QIAA

if BOARD_EFOGTECH_TRBL_52833

config EFOG_TRACKBALL_AXIS_CLAMPER_TUNE
    bool "Enable custom axis clamper tuning"
    default n

config EFOG_TRACKBALL_AXIS_CLAMPER_HISTORY
    int "Axis clamper history size"
    default 3
    depends on EFOG_TRACKBALL_AXIS_CLAMPER_TUNE

config EFOG_TRACKBALL_AXIS_CLAMPER_THRESHOLD
    int "Axis clamper threshold percentage"
    default 2
    depends on EFOG_TRACKBALL_AXIS_CLAMPER_TUNE

config EFOG_TRACKBALL_AXIS_CLAMPER_HYSTERESIS
    int "Axis clamper hysteresis percentage"
    default 1
    depends on EFOG_TRACKBALL_AXIS_CLAMPER_TUNE

config EFOG_TRACKBALL_CPI
    int "Trackball sensor CPI"
    default 3200

config EFOG_TRACKBALL_POINTER_FLIPPED
    bool "Invert pointer axes (rotate trackball 180 degrees)"
    default n
    help
      When enabled, swap the movement direction so the pointer behaves correctly
      when the trackball is used upside-down (both X and Y axes reversed).

endif
```

## boards/shields/single_sensor/Kconfig.shield
```kconfig
# Copyright (c) 2024 Efogtech
# SPDX-License-Identifier: MIT

config SHIELD_SINGLE_SENSOR
	def_bool $(shields_list_contains,single_sensor)
```
